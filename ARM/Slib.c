/********************************************/
/* ASCII 8X16								*/
/********************************************/

#include "44b.h"
#include "44blib.h"
#include "def.h"
#include "option.h"

#include "lcd.h"
#include "lcdlib.h"
#include "glib.h"
#include "slib.h"

#include <stdarg.h>
#include <string.h>
#include <stdlib.h>
#include <stdio.h>
#include <ctype.h>

unsigned char Ascii[]=
{
/*0x00*/  0x00,0x00,0x00,0x00,0x00,0x00,0x00,0x00,
  0x00,0x00,0x00,0x00,0x00,0x00,0x00,0x00,
  0x00,0x00,0x00,0x00,0x00,0x00,0x00,0x00,
  0x00,0x00,0x00,0x00,0x00,0x00,0x00,0x00,
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  0x00,0x00,0x00,0x00,0x00,0x00,0x00,0x00,
  
/*0x10*/  0x00,0x00,0x00,0x00,0x00,0x00,0x00,0x00,
  0x00,0x00,0x00,0x00,0x00,0x00,0x00,0x00,
  0x00,0x00,0x00,0x00,0x00,0x00,0x00,0x00,
  0x00,0x00,0x00,0x00,0x00,0x00,0x00,0x00,
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  0x00,0x00,0x00,0x00,0x00,0x00,0x00,0x00,
  
/*0x20*/  0x00,0x00,0x00,0x00,0x00,0x00,0x00,0x00,/* */
0x00,0x00,0x00,0x00,0x00,0x00,0x00,0x00,
0x00,0x00,0x18,0x3c,0x3c,0x3c,0x18,0x18,/*!*/
0x18,0x00,0x18,0x18,0x00,0x00,0x00,0x00,
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0xfe,0xfe,0xfe,0xfe,0xfe,0xfe,0xfe,0xfe
}; 

U16	Cursor=0;		//定义光标 0～～600 以字符为单位




void Slib_Init(void)
{
	Cursor=0;
}

//设置光标位置
void Slib_SetCursor(U8 y,U8 x)
{
	Cursor=y*40+x;	
}


void Slib_PutChar(U8 y,U8 x,char *pchar)
{
	U8 temp_char;
	U8 i;
	
	temp_char=(unsigned char)*pchar;
//	temp_char=0x30;
	
	for (i=0;i<16;i++)
	{
		frameBuffer1[y*16+i][(unsigned char)(x/4)] &= ~((U32)(0xff << (8*(3-(x%4)))));
		frameBuffer1[y*16+i][(unsigned char)(x/4)] |= (Ascii[temp_char*16+i]) << (8*(3-(x%4)));
	}
}

void Slib_PutStr(char *pstr)
{
	U8 xx,yy;

  	while(*pstr)
  	{
  	if(*pstr=='\n')
  	{
  		Cursor=((U8)(Cursor/40)+1)*40;
  		pstr++;
  	}
  	xx=(U8)(Cursor%40);
  	yy=(U8)(Cursor/40);
  	
    Slib_PutChar(yy,xx,pstr);
    pstr++;
    Cursor++;
    if(Cursor == 600)			//超出屏幕范围 15行 X 40个字符＝600
    	Cursor=0;	
  	}
}

//显示字符串
void Slib_Printf(char *fmt,...) 
{
  va_list ap;
  char string[256];

  va_start(ap,fmt);
  vsprintf(string,fmt,ap);
  Slib_PutStr(string);
  va_end(ap);
  //Reflash_LCD();
}

//清显示缓冲区
void Slib_ClearScr(void)
{
    int i,j;

    for(j=0;j<240;j++)
        for(i=0;i<80;i++)
        {
            
			frameBuffer1[j][i]=0x00000000;

        }
}
//
//void Slib_PutChar_Color(U8 y,U8 x,char *pchar,U8 C)
//{
//	U8 temp_char;
//	U8 i,j;
//	
//	temp_char=(unsigned char)*pchar;
////	temp_char=0x30;
//	
//	for (i=0;i<16;i++)
//	{
//          for(j=0;j<8;j++)
//            {
//		frameBuffer1[y*16+i][(unsigned char)((x+j)/4)] &= ~((U32)(0xff << (8*(3-(x%4)))));
//		 if((Ascii[temp_char*16+i]&(0x80>>j))!=0)
//		frameBuffer1[y*16+i][(unsigned char)((x+j)/4)] |= (C) << (8*(3-(x%4)));
//	}
//}

//void Slib_PutStr_Color(char *pstr,U8 color)
//{
//	U8 xx,yy;
//	U8 str;
//  	while(*pstr)
//  	{
//  	//str=(unsigned char)*pstr;
//  	if(*pstr=='\n')
//  	{
//  		Cursor=((U8)(Cursor/40)+1)*40;
//  		pstr++;
//  	}
//  	xx=(U8)(Cursor%40);
//  	yy=(U8)(Cursor/40);
//  	
//    Slib_PutChar_Color(yy,xx,/*str*/pstr,color);
//    pstr++;
//    Cursor++;
//    if(Cursor == 600)			//超出屏幕范围 15行 X 40个字符＝600
//    	Cursor=0;	
//  	}
//}
////显示字符串
//void Slib_Printf(char *fmt,...) 
//{
//  va_list ap;
//  char string[256];
//
//  va_start(ap,fmt);
//  vsprintf(string,fmt,ap);
//  Slib_PutStr(string);
//  va_end(ap);
//  //Reflash_LCD();
//}
//
////清显示缓冲区
//void Slib_ClearScr(void)
//{
//    int i,j;
//
//    for(j=0;j<240;j++)
//        for(i=0;i<10;i++)
//        {
//            
//			frameBuffer1[j][i]=0x00000000;
//
//        }
//}
